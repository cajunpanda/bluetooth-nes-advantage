## firmware/sdkconfig.defaults
```kconfig
# Indicative defaults, reconcile against your ESP-IDF version with `idf.py menuconfig`.
# Kconfig key names drift between IDF releases; treat this as a starting point.
# Toolchain in use: ESP-IDF v6.0.1 (PlatformIO framework-espidf).

# --- Target ---
CONFIG_IDF_TARGET="esp32"

# --- Bluetooth: dual-mode controller, two host stacks ---
# The controller is compiled BTDM (both BR/EDR and BLE) so the firmware can bring up either radio
# at boot from the NVS transport setting (Classic Switch Pro in bt_pro_btstack or BLE gamepad in
# bt_ble), one radio at a time: the unused half's controller RAM is released at runtime in each
# transport's init().
#
# The two radios use different host stacks, one per boot, both over the controller's VHCI:
#   * Classic (Switch Pro)  -> BTstack, vendored in components/btstack (see its README for why).
#   * BLE gameplay + config/OTA boot mode -> Bluedroid, below.
# Bluedroid Classic is therefore OFF: nothing uses it, it costs flash, and its sdp_init symbol
# collides with BTstack's. Turning it off also drops BT_HID*/BT_SDP_COMMON/BT_SSP, which are all
# Classic-only.
CONFIG_BT_ENABLED=y
CONFIG_BT_BLUEDROID_ENABLED=y
CONFIG_BTDM_CTRL_MODE_BTDM=y          # controller supports both BR/EDR and BLE
CONFIG_BTDM_CTRL_HCI_MODE_VHCI=y      # BTstack talks to the controller over VHCI
CONFIG_BT_CLASSIC_ENABLED=n
CONFIG_BT_BLE_ENABLED=y
# BLE GATT server + SMP bonding for the BLE HID transport (bt_ble).
CONFIG_BT_GATTS_ENABLE=y
CONFIG_BT_BLE_SMP_ENABLE=y

# --- Power management: no CPU PM, but BT modem sleep is compiled in ---
# CPU PM + tickless idle push the ACL link into sniff mode. During the Switch handshake that
# causes rapid sniff/unsniff churn (our ~66Hz 0x30 stream fights the sniff requests) which tears
# the connection down before the handshake finishes. Keep them off; deep sleep is handled
# separately by the ULP path.
#
# BT modem sleep (ORIG mode, main-XTAL low-power clock) is compiled in for the BLE transport:
# combined with slave latency it lets the controller power the radio down between connection
# events (BLE connected ~114 -> ~61 mA at 240 MHz, bench 2026-07-14; see bt_ble.cpp). The Classic
# transport calls esp_bt_sleep_disable() in its init, so BR/EDR behaves exactly like a build
# without modem sleep: the handshake never sees it, and it saves nothing on a connected Classic
# link anyway (the QoS-pinned active ACL keeps RX on regardless).
CONFIG_PM_ENABLE=n
CONFIG_FREERTOS_USE_TICKLESS_IDLE=n
CONFIG_BTDM_CTRL_MODEM_SLEEP=y
CONFIG_BTDM_CTRL_MODEM_SLEEP_MODE_ORIG=y
CONFIG_BTDM_CTRL_LPCLK_SEL_MAIN_XTAL=y

# --- Input responsiveness: 1 kHz tick; CPU at 80 MHz for battery life ---
# Input lag is gated by how often app_main can re-poll the 4021. The default 100 Hz FreeRTOS tick
# floors vTaskDelay() at 10 ms, so the loop samples every 10 ms no matter what we ask for. A 1 kHz
# tick lets the loop poll at ~2 ms, cutting the average sampling latency from ~5 ms to ~1 ms. All
# firmware delays use pdMS_TO_TICKS(), so they rescale automatically.
#
# CPU runs at 80 MHz (was 240): bench 2026-07-14 measured -23 mA in every state (~+24% Classic
# playtime, 1800 mAh ~13.6 -> ~17 h) with no radio-timing change. The 4021 read grows ~0.13 ->
# ~0.4 ms inside the unchanged 2 ms poll loop - noise against the 10-16 ms BT link budget. Full
# handshake + gameplay validated at 80 MHz against a real Switch and an 8BitDo receiver.
CONFIG_ESP_DEFAULT_CPU_FREQ_MHZ_80=y
CONFIG_ESP_DEFAULT_CPU_FREQ_MHZ=80
CONFIG_FREERTOS_HZ=1000

# --- ULP-FSM coprocessor (sleep-time 4021 polling) ---
CONFIG_ULP_COPROC_ENABLED=y
CONFIG_ULP_COPROC_TYPE_FSM=y
CONFIG_ULP_COPROC_RESERVE_MEM=1024

# --- Large app partition for the BT stack ---
CONFIG_PARTITION_TABLE_CUSTOM=y
CONFIG_PARTITION_TABLE_CUSTOM_FILENAME="partitions.csv"

# --- 4 MB flash: the dual-OTA table (ota_0/ota_1 + otadata) spans ~3.6 MB; the WROOM-32E is >=4 MB.
CONFIG_ESPTOOLPY_FLASHSIZE_4MB=y
CONFIG_ESPTOOLPY_FLASHSIZE="4MB"

# --- BLE OTA rollback/verify: keep it simple, accept a new app as valid on first boot (no app
# self-test handshake). esp_ota_set_boot_partition + reboot is enough for this device.
CONFIG_BOOTLOADER_APP_ROLLBACK_ENABLE=n
```
